## boards/shields/mykeyball/Kconfig.defconfig
```kconfig
if SHIELD_MYKEYBALL_RIGHT

config ZMK_KEYBOARD_NAME
    default "MyKeyball"

config ZMK_SPLIT_ROLE_CENTRAL
    default y

config ZMK_USB
    default y
endif



if SHIELD_MYKEYBALL_LEFT || SHIELD_MYKEYBALL_RIGHT || SHIELD_MYKEYBALL_DONGLE 

config ZMK_SPLIT
    default y

config ZMK_BLE
    default y
endif
```

## config/west.yml
```yaml
# used in keyball
manifest:
  remotes:
    - name: zmkfirmware
      url-base: https://github.com/petejohanson
    - name: inorichi
      url-base: https://github.com/inorichi
    # Additional modules containing boards/shields/custom code can be listed here as well
    # See https://docs.zephyrproject.org/3.2.0/develop/west/manifest.html#projects
    - name: englmaxi
      url-base: https://github.com/englmaxi/
  projects:
    - name: zmk
      remote: zmkfirmware
      revision: feat/pointers-move-scroll
      import: app/west.yml
    - name: zmk-pmw3610-driver
      remote: inorichi
      revision: main
    - name: zmk-config
      remote: englmaxi
      revision: master
  self:
    path: config

# used in myhand
#manifest:
# remotes:
#    - name: zmkfirmware
#      url-base: https://github.com/zmkfirmware
#    # Additional modules containing boards/shields/custom code can be listed here as well
#    # See https://docs.zephyrproject.org/3.2.0/develop/west/manifest.html#projects
#  projects:
#    - name: zmk
#      remote: zmkfirmware
#      revision: main
#      import: app/west.yml
#  self:
#    path: config
```
